## west.yml
```yaml
manifest:
  version: "1.2"

  remotes:
    - name: zephyrproject-rtos
      url-base: https://github.com/zephyrproject-rtos

  projects:
    - name: zephyr
      remote: zephyrproject-rtos
      revision: v4.2.2
      path: deps/zephyr
      import:
        name-allowlist:
          - cmsis
          - cmsis_6
          - hal_stm32
          - mbedtls
          - mcuboot
          - tinycrypt

  self:
    path: .
```
